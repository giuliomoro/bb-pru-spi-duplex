/*
* Copyright (C) 2013 Matt Ranostay <mranostay@gmail.com>
*
* This program is free software; you can redistribute it and/or modify
* it under the terms of the GNU General Public License version 2 as
* published by the Free Software Foundation.
*/
/dts-v1/;
/plugin/;

/ {
	compatible = "ti,beaglebone", "ti,beaglebone-black", "ti,beaglebone-green";

	/* identification */
	part-number = "BB-BONE-PRU-BITBANG-SPI";
	version = "00A0";

	/* state the resources this cape uses */
	exclusive-use =
		/* the slave uses */
		"P8.43",	/* pru1: pr1_pru1_pru_r30_2 */
		"P8.44",	/* pru1: pr1_pru1_pru_r31_3 */
		"P8.45",	/* pru1: pr1_pru1_pru_r31_0 */
		"P8.46",	/* pru1: pr1_pru1_pru_r31_1 */
		/* the master uses */
		"P9_27",    /* pr1_pru0_pru_r30_5 */
		"P8_11",    /* pr1_pru0_pru_r30_15 */
		"P8_12",    /* pr1_pru0_pru_r30_14 */
		"P8_15",    /* pr1_pru0_pru_r31_15 */
		/* the hardware IP uses */
		"pru0",
		"pru1";

	fragment@0 {
		target = <&am33xx_pinmux>;
		__overlay__ {

			pru_bela_pins: pinmux_pru_bela_pins {
				pinctrl-single,pins = <
					/* slave pins */
					0x0ac 0x26	/* lcd_data3.pr1_pru1_pru_r31_3, MODE6 | INPUT  | PRU */
					0x0a0 0x26	/* lcd_data0.pr1_pru1_pru_r31_0, MODE6 | INPUT | PRU */
					0x0a4 0x26	/* lcd_data1.pr1_pru1_pru_r31_1, MODE6 | INPUT | PRU */
					0x0a8 0x25	/* lcd_data2.pr1_pru1_pru_r30_2, MODE5 | OUTPUT | PRU */
					/* master pins */
					0x1a4 0x25  /* pr1_pru0_pru_r30_5, MODE 5 | OUTPUT | PRU */
					0x03c 0x26  /* pr1_pru0_pru_r31_15, MODE 6 | INPUT | PRU */
					0x034 0x26  /* pr1_pru0_pru_r30_15, MODE 6 | OUTPUT | PRU */
					0x030 0x26  /* pr1_pru0_pru_r30_14, MODE 6 | OUTPUT | PRU */
				>;
			};
		};
	};

	fragment@2 {
		target = <&pruss>;
		__overlay__ {
			status = "okay";

			pinctrl-names = "default";
			pinctrl-0 = <&pru_bela_pins>;
		};
	};
};
